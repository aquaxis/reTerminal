## sdkconfig.defaults
```kconfig
# ESP32-S3 specific configuration
CONFIG_IDF_TARGET="esp32s3"
CONFIG_IDF_TARGET_ESP32S3=y

# Serial flasher config
CONFIG_ESPTOOLPY_FLASHSIZE_8MB=y
CONFIG_ESPTOOLPY_FLASHSIZE="8MB"
CONFIG_ESPTOOLPY_FLASHMODE_QIO=y

# Partition Table
CONFIG_PARTITION_TABLE_CUSTOM=n
CONFIG_PARTITION_TABLE_TWO_OTA=y

# PSRAM
CONFIG_ESP32S3_SPIRAM_SUPPORT=y
CONFIG_SPIRAM_MODE_OCT=y
CONFIG_SPIRAM_SPEED_80M=y

# CPU frequency
CONFIG_ESP32S3_DEFAULT_CPU_FREQ_240=y
CONFIG_ESP32S3_DEFAULT_CPU_FREQ_MHZ=240

# FreeRTOS
CONFIG_FREERTOS_HZ=1000
CONFIG_FREERTOS_USE_TRACE_FACILITY=y
CONFIG_FREERTOS_USE_STATS_FORMATTING_FUNCTIONS=y

# Log output
CONFIG_LOG_DEFAULT_LEVEL_INFO=y
CONFIG_LOG_MAXIMUM_LEVEL_VERBOSE=y
CONFIG_LOG_COLORS=y

# WiFi
CONFIG_ESP32_WIFI_STATIC_RX_BUFFER_NUM=10
CONFIG_ESP32_WIFI_DYNAMIC_RX_BUFFER_NUM=32
CONFIG_ESP32_WIFI_DYNAMIC_TX_BUFFER_NUM=32

# Power Management
CONFIG_PM_ENABLE=y
CONFIG_PM_DFS_INIT_AUTO=y

# Watchdog
CONFIG_ESP_TASK_WDT=y
CONFIG_ESP_TASK_WDT_TIMEOUT_S=10
CONFIG_ESP_TASK_WDT_PANIC=n

# HTTP Server
CONFIG_HTTPD_MAX_REQ_HDR_LEN=1024
CONFIG_HTTPD_MAX_URI_LEN=512

# FAT Filesystem
CONFIG_FATFS_LFN_HEAP=y
CONFIG_FATFS_MAX_LFN=255

# SPI
CONFIG_SPI_MASTER_ISR_IN_IRAM=y

# E-Paper Configuration
CONFIG_EPAPER_MOSI_GPIO=9
CONFIG_EPAPER_SCLK_GPIO=7
CONFIG_EPAPER_CS_GPIO=10
CONFIG_EPAPER_DC_GPIO=11
CONFIG_EPAPER_RST_GPIO=12
CONFIG_EPAPER_BUSY_GPIO=13
```

## src/Kconfig.projbuild
```kconfig
menu "reTerminal E1002 Configuration"

    config EPAPER_MOSI_GPIO
        int "E-Paper MOSI GPIO number"
        range 0 48
        default 9
        help
            GPIO number (IOxx) for E-Paper MOSI/DIN signal.

    config EPAPER_SCLK_GPIO
        int "E-Paper SCLK GPIO number"
        range 0 48
        default 8
        help
            GPIO number (IOxx) for E-Paper SCLK/CLK signal.

    config EPAPER_CS_GPIO
        int "E-Paper CS GPIO number"
        range 0 48
        default 7
        help
            GPIO number (IOxx) for E-Paper CS (Chip Select) signal.

    config EPAPER_DC_GPIO
        int "E-Paper DC GPIO number"
        range 0 48
        default 6
        help
            GPIO number (IOxx) for E-Paper DC (Data/Command) signal.

    config EPAPER_RST_GPIO
        int "E-Paper RST GPIO number"
        range 0 48
        default 5
        help
            GPIO number (IOxx) for E-Paper RST (Reset) signal.

    config EPAPER_BUSY_GPIO
        int "E-Paper BUSY GPIO number"
        range 0 48
        default 4
        help
            GPIO number (IOxx) for E-Paper BUSY signal.

    config EPAPER_WIDTH
        int "E-Paper display width"
        default 800
        help
            Width of the e-paper display in pixels.

    config EPAPER_HEIGHT
        int "E-Paper display height"
        default 480
        help
            Height of the e-paper display in pixels.

    config ENABLE_PARTIAL_UPDATE
        bool "Enable partial update support"
        default y
        help
            Enable partial update feature for faster screen updates.

    config ENABLE_SD_CARD
        bool "Enable SD Card support"
        default y
        help
            Enable SD Card support for storing images and configurations.

    config ENABLE_WIFI
        bool "Enable WiFi support"
        default y
        help
            Enable WiFi connectivity features.

endmenu
```
